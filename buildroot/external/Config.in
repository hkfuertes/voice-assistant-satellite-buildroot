## buildroot/external/Config.in
```kconfig
source "$BR2_EXTERNAL_CUSTOM_PACKAGES_PATH/package/expand-rootfs/Config.in"
source "$BR2_EXTERNAL_CUSTOM_PACKAGES_PATH/package/extra-configs/Config.in"
source "$BR2_EXTERNAL_CUSTOM_PACKAGES_PATH/package/linux-voice-assistant/Config.in"
source "$BR2_EXTERNAL_CUSTOM_PACKAGES_PATH/package/python-aioesphomeapi/Config.in"
source "$BR2_EXTERNAL_CUSTOM_PACKAGES_PATH/package/python-async-interrupt/Config.in"
source "$BR2_EXTERNAL_CUSTOM_PACKAGES_PATH/package/python-chacha20poly1305-reuseable/Config.in"
source "$BR2_EXTERNAL_CUSTOM_PACKAGES_PATH/package/python-mpv/Config.in"
source "$BR2_EXTERNAL_CUSTOM_PACKAGES_PATH/package/python-noiseprotocol/Config.in"
source "$BR2_EXTERNAL_CUSTOM_PACKAGES_PATH/package/python-pymicro-features/Config.in"
source "$BR2_EXTERNAL_CUSTOM_PACKAGES_PATH/package/python-pyring-buffer/Config.in"
source "$BR2_EXTERNAL_CUSTOM_PACKAGES_PATH/package/python-sounddevice/Config.in"
source "$BR2_EXTERNAL_CUSTOM_PACKAGES_PATH/package/python-wyoming/Config.in"
source "$BR2_EXTERNAL_CUSTOM_PACKAGES_PATH/package/rpi-utils/Config.in"
source "$BR2_EXTERNAL_CUSTOM_PACKAGES_PATH/package/seeed-voicecard/Config.in"
source "$BR2_EXTERNAL_CUSTOM_PACKAGES_PATH/package/tensorflow-lite-c/Config.in"
source "$BR2_EXTERNAL_CUSTOM_PACKAGES_PATH/package/usb-gadget/Config.in"
source "$BR2_EXTERNAL_CUSTOM_PACKAGES_PATH/package/wifi-autoconfig/Config.in"
source "$BR2_EXTERNAL_CUSTOM_PACKAGES_PATH/package/wma8960-config/Config.in"
source "$BR2_EXTERNAL_CUSTOM_PACKAGES_PATH/package/wyoming-openwakeword/Config.in"
source "$BR2_EXTERNAL_CUSTOM_PACKAGES_PATH/package/wyoming-satellite/Config.in"
```

## buildroot/external/configs/lva_usb_amd64_lxc_defconfig
```kconfig
BR2_x86_64=y
BR2_TOOLCHAIN_EXTERNAL=y
BR2_TOOLCHAIN_EXTERNAL_BOOTLIN_X86_64_GLIBC_STABLE=y
BR2_TARGET_OPTIMIZATION="-march=x86-64 -mtune=generic -O2"
BR2_DOWNLOAD_FORCE_CHECK_HASHES=y
BR2_TARGET_GENERIC_HOSTNAME="VoiceAssistant"
BR2_TARGET_GENERIC_ISSUE="Welcome to Voice Assistant"
BR2_ROOTFS_DEVICE_CREATION_DYNAMIC_EUDEV=y
BR2_TARGET_GENERIC_ROOT_PASSWD="toor"
BR2_SYSTEM_DHCP="eth0"
BR2_ROOTFS_POST_BUILD_SCRIPT="$(BR2_EXTERNAL_CUSTOM_PACKAGES_PATH)/board/proxmox/post-build.sh"
BR2_ROOTFS_POST_IMAGE_SCRIPT="$(BR2_EXTERNAL_CUSTOM_PACKAGES_PATH)/board/proxmox/post-image.sh"
BR2_PACKAGE_BUSYBOX_SHOW_OTHERS=y
BR2_PACKAGE_XZ=y
BR2_PACKAGE_PYTHON3=y
BR2_PACKAGE_READLINE=y
BR2_PACKAGE_NANO=y
BR2_TARGET_ROOTFS_TAR_XZ=y
BR2_PACKAGE_HOST_PYTHON3_SSL=y
BR2_PACKAGE_EXPAND_ROOTFS=y
BR2_PACKAGE_EXTRA_CONFIGS=y
BR2_PACKAGE_LINUX_VOICE_ASSISTANT=y
BR2_PACKAGE_TRIGGERHAPPY_CONFIG=y
```

## buildroot/external/package/expand-rootfs/Config.in
```kconfig
config BR2_PACKAGE_EXPAND_ROOTFS
	bool "expand-rootfs"
	select BR2_PACKAGE_E2FSPROGS
	select BR2_PACKAGE_E2FSPROGS_RESIZE2FS
	select BR2_PACKAGE_UTIL_LINUX
	select BR2_PACKAGE_UTIL_LINUX_BINARIES
	help
	  Automatically expand root filesystem to fill entire SD card
	  on first boot.
	  
	  This package uses sfdisk to expand the root partition and
	  resize2fs to expand the ext4 filesystem. The process happens
	  in two phases with an automatic reboot in between:
	  
	  Boot 1: Expand partition, reboot
	  Boot 2: Expand filesystem, complete
	  
	  After expansion, /RESIZED flag prevents re-execution.
	  
	  Required tools:
	  - sfdisk (from util-linux)
	  - resize2fs (from e2fsprogs)
	  
	  The root partition will use all available space on the SD card.
```

## buildroot/external/package/linux-voice-assistant/Config.in
```kconfig
config BR2_PACKAGE_LINUX_VOICE_ASSISTANT
	bool "linux-voice-assistant"
	depends on BR2_PACKAGE_PYTHON3
	select BR2_PACKAGE_MPV
	select BR2_PACKAGE_PORTAUDIO
	select BR2_PACKAGE_TENSORFLOW_LITE
	select BR2_PACKAGE_HOST_PYTHON_PIP
	select BR2_PACKAGE_PYTHON_NUMPY
	select BR2_PACKAGE_PYTHON_ZEROCONF
	select BR2_PACKAGE_PYTHON_CFFI
	select BR2_PACKAGE_PYTHON_CRYPTOGRAPHY
	select BR2_PACKAGE_PYTHON_PROTOBUF
	select BR2_PACKAGE_PYTHON_AIOESPHOMEAPI
	select BR2_PACKAGE_PYTHON_SOUNDCARD
	select BR2_PACKAGE_PYTHON_MPV
	select BR2_PACKAGE_PYTHON_PYMICRO_WAKEWORD
	select BR2_PACKAGE_PYTHON_PYOPENWAKEWORD
  	select BR2_PACKAGE_ALSA_LIB
    select BR2_PACKAGE_ALSA_UTILS
    select BR2_PACKAGE_ALSA_PLUGINS
    select BR2_PACKAGE_ALSA_UTILS_ALSAUCM
    select BR2_PACKAGE_ALSA_UTILS_ALSACONF
    select BR2_PACKAGE_LIBSAMPLERATE
	help
	  Voice satellite for Home Assistant using ESPHome protocol.
	  
	  Runs on aarch64 and x86_64 platforms with Python 3.11+.
	  Supports announcements, start/continue conversation, and timers.
	  
	  https://github.com/OHF-Voice/linux-voice-assistant

if BR2_PACKAGE_LINUX_VOICE_ASSISTANT

config BR2_PACKAGE_LINUX_VOICE_ASSISTANT_NAME
	string "Satellite name"
	default "VoiceSatellite"
	help
	  Name that will be available in Home Assistant.

config BR2_PACKAGE_LINUX_VOICE_ASSISTANT_WAKE_MODEL
	string "Wake word model"
	default "ok_nabu"
	help
	  Wake word model to use (e.g., ok_nabu, hey_jarvis).
	  Model file must exist in wakewords/ directory.

config BR2_PACKAGE_LINUX_VOICE_ASSISTANT_AUDIO_INPUT
	string "Audio input device"
	default ""
	help
	  PortAudio input device name. Leave empty for default.
	  Use 'python3 -m sounddevice' to list available devices.

config BR2_PACKAGE_LINUX_VOICE_ASSISTANT_AUDIO_OUTPUT
	string "Audio output device"
	default ""
	help
	  MPV output device name. Leave empty for default.
	  Use 'mpv --audio-device=help' to list available devices.

endif

comment "linux-voice-assistant needs Python3"
	depends on !BR2_PACKAGE_PYTHON3
```

## buildroot/external/package/python-aioesphomeapi/Config.in
```kconfig
config BR2_PACKAGE_PYTHON_AIOESPHOMEAPI
	bool "python-aioesphomeapi"
	depends on BR2_PACKAGE_PYTHON3
	select BR2_PACKAGE_PYTHON_PROTOBUF
	select BR2_PACKAGE_PYTHON_CRYPTOGRAPHY
	select BR2_PACKAGE_PYTHON_AIOHAPPYEYEBALLS
	select BR2_PACKAGE_PYTHON_ASYNC_INTERRUPT
	select BR2_PACKAGE_PYTHON_ASYNC_INTERRUPT
	select BR2_PACKAGE_PYTHON_CHACHA20POLY1305_REUSEABLE
	select BR2_PACKAGE_PYTHON_NOISEPROTOCOL
	select BR2_PACKAGE_PYTHON_TZLOCAL
	help
	  Python client for ESPHome API
```

## buildroot/external/package/python-async-interrupt/Config.in
```kconfig
config BR2_PACKAGE_PYTHON_ASYNC_INTERRUPT
	bool "python-async-interrupt"
	help
	  Interrupt context manager for asyncio
```

## buildroot/external/package/python-noiseprotocol/Config.in
```kconfig
config BR2_PACKAGE_PYTHON_NOISEPROTOCOL
	bool "python-noiseprotocol"
	select BR2_PACKAGE_PYTHON_CRYPTOGRAPHY
	help
	  Implementation of Noise Protocol Framework
```

## buildroot/external/package/python-numpy-wheel/Config.in
```kconfig
config BR2_PACKAGE_PYTHON_NUMPY_WHEEL
    bool "python-numpy-wheel"
    depends on BR2_PACKAGE_PYTHON3
    depends on BR2_aarch64 || BR2_arm || BR2_x86_64
    help
      NumPy wheel precompiled with optimizations for multiple architectures.
      
      Supports:
      - aarch64: ARM 64-bit with SIMD optimizations
      - armv7l: ARM 32-bit
      - x86_64: AMD64/Intel 64-bit

comment "python-numpy-wheel needs aarch64, arm or x86_64"
    depends on !BR2_aarch64 && !BR2_arm && !BR2_x86_64
```

## buildroot/external/package/python-pymicro-features/Config.in
```kconfig
config BR2_PACKAGE_PYTHON_PYMICRO_FEATURES
	bool "python-pymicro-features"
	help
	  Speech features using TFLite Micro audio frontend

	  https://github.com/rhasspy/pymicro-features
```

## buildroot/external/package/python-pymicro-wakeword/Config.in
```kconfig
config BR2_PACKAGE_PYTHON_PYMICRO_WAKEWORD
	bool "python-pymicro-wakeword"
	depends on BR2_PACKAGE_PYTHON3
	select BR2_PACKAGE_PYTHON_NUMPY
	select BR2_PACKAGE_PYTHON_PYMICRO_FEATURES
	help
	  A TensorFlow based wake word detection library using pre-compiled
	  TensorFlow Lite models suitable for microcontrollers.
	  
	  https://github.com/OHF-Voice/pymicro-wakeword
```

## buildroot/external/package/python-pyopenwakeword/Config.in
```kconfig
config BR2_PACKAGE_PYTHON_PYOPENWAKEWORD
	bool "python-pyopenwakeword"
	depends on BR2_PACKAGE_PYTHON3
	select BR2_PACKAGE_PYTHON_NUMPY_WHEEL
	select BR2_PACKAGE_TENSORFLOW_LITE
	help
	  Alternative Python library for openWakeWord with pre-compiled TensorFlow Lite
	  https://github.com/rhasspy/pyopen-wakeword
```

## buildroot/external/package/python-pyring-buffer/Config.in
```kconfig
config BR2_PACKAGE_PYTHON_PYRING_BUFFER
	bool "python-pyring-buffer"
	depends on BR2_PACKAGE_PYTHON3
	help
	  Pure Python ring/circular buffer for bytes
	  https://github.com/rhasspy/pyring-buffer
```

## buildroot/external/package/python-soundcard/Config.in
```kconfig
config BR2_PACKAGE_PYTHON_SOUNDCARD
	bool "python-soundcard"
	depends on BR2_PACKAGE_PYTHON3
	select BR2_PACKAGE_PYTHON_CFFI
	select BR2_PACKAGE_PYTHON_NUMPY_WHEEL
	select BR2_PACKAGE_PULSEAUDIO
	select BR2_PACKAGE_PULSEAUDIO_DAEMON
	help
	  A Pure-Python real-time audio I/O library for recording and playing
	  audio on Linux (PulseAudio), macOS (CoreAudio), and Windows (WASAPI).
	  
	  https://github.com/bastibe/soundcard
```

## buildroot/external/package/python-sounddevice/Config.in
```kconfig
config BR2_PACKAGE_PYTHON_SOUNDDEVICE
	bool "python-sounddevice"
	depends on BR2_PACKAGE_PYTHON3
	select BR2_PACKAGE_PYTHON_CFFI
	select BR2_PACKAGE_PORTAUDIO
	help
	  Play and Record Sound with Python
	  
	  https://python-sounddevice.readthedocs.io
```

## buildroot/external/package/python-wyoming/Config.in
```kconfig
config BR2_PACKAGE_PYTHON_WYOMING
    bool "python-wyoming"
    depends on BR2_PACKAGE_PYTHON3
    help
      Wyoming is a peer-to-peer protocol for voice assistants.
      Used in Rhasspy and Home Assistant for communication with
      voice services.
      
      https://github.com/OHF-Voice/wyoming
```

## buildroot/external/package/respeaker/Config.in
```kconfig
config BR2_PACKAGE_RESPEAKER
	bool "respeaker"
	depends on BR2_LINUX_KERNEL
	select BR2_PACKAGE_DTC
	select BR2_PACKAGE_DTC_PROGRAMS
	select BR2_PACKAGE_ALSA_UTILS
	select BR2_PACKAGE_ALSA_UTILS_AMIXER
	select BR2_PACKAGE_ALSA_UTILS_ALSACTL
	select BR2_PACKAGE_ALSA_UTILS_APLAY
	help
	  The ReSpeaker series is a family of 
	  development boards designed to enable 
	  a future where voice interface is part 
	  of everyday human-device interaction. 
	  Designed to be easily integrated (and 
	  customized) into products, but also to 
	  allow other services and products to be 
	  easily integrated into it.

	  https://respeaker.io/
```

## buildroot/external/package/rpi-utils/Config.in
```kconfig
config BR2_PACKAGE_RPI_UTILS
    bool "rpi-utils"
    depends on BR2_arm || BR2_aarch64
    depends on !BR2_STATIC_LIBS
    select BR2_PACKAGE_DTC
    help
      Collection of Raspberry Pi utilities including
      dtoverlay, dtparam, vcgencmd, etc.
      
      https://github.com/raspberrypi/utils
```

## buildroot/external/package/seeed-voicecard/Config.in
```kconfig
config BR2_PACKAGE_SEEED_VOICECARD
	bool "seed-voicecard"
	select BR2_PACKAGE_DTC
	select BR2_PACKAGE_DTC_PROGRAMS
	select BR2_PACKAGE_HOST_DTC
	select BR2_PACKAGE_BASH
	select BR2_PACKAGE_RPI_UTILS
	help
	  The ReSpeaker series is a family of 
	  development boards designed to enable 
	  a future where voice interface is part 
	  of everyday human-device interaction. 
	  Designed to be easily integrated (and 
	  customized) into products, but also to 
	  allow other services and products to be 
	  easily integrated into it.

	  https://respeaker.io/
```

## buildroot/external/package/tensorflow-lite-c-prebuilt/Config.in
```kconfig
config BR2_PACKAGE_TENSORFLOW_LITE_C_PREBUILT
	bool "tensorflow-lite-c-prebuilt"
	help
	  TensorFlow Lite C library (prebuilt binaries)
	  
	  This package provides precompiled TensorFlow Lite C shared
	  libraries for amd64 and arm64 architectures.
	  
	  Version: 2.17.1
	  
	  https://www.tensorflow.org/lite
```

## buildroot/external/package/triggerhappy-config/Config.in
```kconfig
config BR2_PACKAGE_TRIGGERHAPPY_CONFIG
	bool "triggerhappy-config"
	select BR2_PACKAGE_TRIGGERHAPPY
	help
	  Configuration files for triggerhappy daemon to handle
	  eMeet M1A speakerphone buttons.
	  
	  Maps volume buttons to ALSA volume controls.
```

## buildroot/external/package/wifi-autoconfig/Config.in
```kconfig
config BR2_PACKAGE_WIFI_AUTOCONFIG
	bool "wifi-autoconfig"
	depends on BR2_USE_MMU # wpa_supplicant
	depends on BR2_PACKAGE_BUSYBOX_SHOW_OTHERS || BR2_PACKAGE_UTIL_LINUX
	select BR2_PACKAGE_WPA_SUPPLICANT
	select BR2_PACKAGE_WPA_SUPPLICANT_CLI
	select BR2_PACKAGE_WPA_SUPPLICANT_PASSPHRASE
	select BR2_PACKAGE_WIRELESS_REGDB
	select BR2_PACKAGE_WIRELESS_TOOLS
	select BR2_PACKAGE_WPA_SUPPLICANT_WPA3
	help
	  Base system configuration for Raspberry Pi Zero 2 W including:
	  - WiFi module configuration (brcmfmac)
	  - Automatic WiFi setup from /boot/wpa_supplicant.conf
	  - Network auto-configuration with wpa_supplicant
	  
	  Place a wpa_supplicant.conf file in the /boot partition
	  to automatically configure WiFi on first boot.

if BR2_PACKAGE_WIFI_AUTOCONFIG

config BR2_PACKAGE_WIFI_AUTOCONFIG_ENABLE_DHCP
	bool "Enable automatic DHCP client"
	default y
	help
	  Automatically start DHCP client (udhcpc) after WiFi
	  connection is established.

endif

comment "wifi-autoconfig needs MMU support"
	depends on !BR2_USE_MMU
```

## buildroot/external/package/wma8960-config/Config.in
```kconfig
config BR2_PACKAGE_WMA8960_CONFIG
	bool "wma8960-config"
	depends on BR2_LINUX_KERNEL

	select BR2_PACKAGE_ALSA_UTILS
	select BR2_PACKAGE_ALSA_UTILS_AMIXER
	select BR2_PACKAGE_ALSA_UTILS_ALSACTL
	select BR2_PACKAGE_ALSA_UTILS_APLAY
	help
	  Configuration package for ReSpeaker 2-Mic HAT v1 (WM8960).
	  Installs ALSA configuration and init scripts.

	  IMPORTANT: You must enable the following kernel options:
	  - CONFIG_SND_SOC_WM8960=m
	  - CONFIG_I2C=y

comment "respeaker-config needs a Linux kernel with SND_SOC_WM8960"
	depends on BR2_LINUX_KERNEL && !BR2_LINUX_KERNEL_EXT_RTAI
```

## buildroot/external/package/wyoming-microwakeword/Config.in
```kconfig
config BR2_PACKAGE_WYOMING_MICROWAKEWORD
	bool "wyoming-microwakeword"
	depends on BR2_PACKAGE_PYTHON3
	select BR2_PACKAGE_PYTHON_NUMPY
	select BR2_PACKAGE_HOST_PYTHON_PIP
	help
	  Wyoming protocol server for microWakeWord detection.
	  
	  Lighter and faster alternative to openWakeWord.
	  Optimized for embedded devices like Raspberry Pi.
	  
	  https://github.com/rhasspy/wyoming-microwakeword

comment "wyoming-microwakeword needs Python3"
	depends on !BR2_PACKAGE_PYTHON3
```

## buildroot/external/package/wyoming-openwakeword/Config.in
```kconfig
config BR2_PACKAGE_WYOMING_OPENWAKEWORD
	bool "wyoming-openwakeword"
	depends on BR2_PACKAGE_PYTHON3
	select BR2_PACKAGE_PYTHON_NUMPY
	select BR2_PACKAGE_PYTHON_PYOPENWAKEWORD
	select BR2_PACKAGE_PYTHON_WYOMING
	help
	  Wyoming server for openWakeWord with isolated wyoming 1.8
	  https://github.com/rhasspy/wyoming-openwakeword
```
