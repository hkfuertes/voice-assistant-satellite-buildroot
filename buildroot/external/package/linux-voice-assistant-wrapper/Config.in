## buildroot/external/package/linux-voice-assistant-wrapper/Config.in
```kconfig
config BR2_PACKAGE_LINUX_VOICE_ASSISTANT_WRAPPER
	bool "linux-voice-assistant-wrapper"
	depends on BR2_PACKAGE_PYTHON3
	select BR2_PACKAGE_LINUX_VOICE_ASSISTANT
	select BR2_PACKAGE_PYTHON_SPIDEV
	help
	  Wrapper for linux-voice-assistant with LED event support.
	  
	  Provides visual feedback through APA102 LEDs on ReSpeaker 2mic HAT
	  by intercepting voice assistant events and controlling RGB LEDs.
	  
	  https://github.com/hkfuertes/voice-assistant-satellite-buildroot

comment "linux-voice-assistant-wrapper needs Python3"
	depends on !BR2_PACKAGE_PYTHON3
```

## buildroot/external/package/python-getmac/Config.in
```kconfig
config BR2_PACKAGE_PYTHON_GETMAC
	bool "python-getmac"
	depends on BR2_PACKAGE_PYTHON3
	help
	  Pure-Python library to get the MAC address of a local or
	  remote host.

	  https://pypi.org/project/getmac/
```

## buildroot/external/package/python-netifaces2-wheel/Config.in
```kconfig
config BR2_PACKAGE_PYTHON_NETIFACES2_WHEEL
	bool "python-netifaces2-wheel"
	depends on BR2_PACKAGE_PYTHON3
	depends on BR2_aarch64 || BR2_arm || BR2_x86_64
	help
	  Precompiled wheel for netifaces2, a maintained fork of netifaces.
	  Provides network interface information (addresses, flags, etc.).

	  Supports: aarch64, armv7l, x86_64 (cp37-abi3 stable ABI wheels).

	  https://pypi.org/project/netifaces2/

comment "python-netifaces2-wheel needs aarch64, arm or x86_64"
	depends on !BR2_aarch64 && !BR2_arm && !BR2_x86_64
```

## buildroot/external/package/python-webrtc-noise-gain-wheel/Config.in
```kconfig
config BR2_PACKAGE_PYTHON_WEBRTC_NOISE_GAIN_WHEEL
	bool "python-webrtc-noise-gain-wheel"
	depends on BR2_PACKAGE_PYTHON3
	depends on BR2_aarch64 || BR2_x86_64
	help
	  Precompiled wheel for webrtc-noise-gain, Python bindings for the
	  WebRTC noise suppression and automatic gain control algorithms.
	  Used by LVA microphone processing when enabled.

	  Supports: aarch64, x86_64 (cp39-abi3 stable ABI wheels).
	  No armv7l wheel is published upstream; arm 32-bit is unsupported.

	  https://pypi.org/project/webrtc-noise-gain/

comment "python-webrtc-noise-gain-wheel needs aarch64 or x86_64 (no armv7l wheel upstream)"
	depends on !BR2_aarch64 && !BR2_x86_64
```
