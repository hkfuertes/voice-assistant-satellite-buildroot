## buildroot/external/package/wyoming-satellite/Config.in
```kconfig
config BR2_PACKAGE_WYOMING_SATELLITE
    bool "python-wyoming-satellite"
    depends on BR2_PACKAGE_PYTHON3
    select BR2_PACKAGE_PYTHON_SPIDEV
    select BR2_PACKAGE_PYTHON_NUMPY
    select BR2_PACKAGE_PYTHON_ZEROCONF
    select BR2_PACKAGE_ALSA_LIB
    select BR2_PACKAGE_ALSA_UTILS
    select BR2_PACKAGE_PYTHON_WYOMING
    select BR2_PACKAGE_PYTHON_PYRING_BUFFER
    help
      Wyoming Satellite is a voice assistant client that connects
      to a Wyoming server for voice recognition and synthesis.
      
      https://github.com/rhasspy/wyoming-satellite

if BR2_PACKAGE_WYOMING_SATELLITE
    config BR2_PACKAGE_WYOMING_SATELLITE_NAME
        string "Satellite name"
        default "wyoming-satellite"
        help
          Name of the satellite instance

    config BR2_PACKAGE_WYOMING_SATELLITE_WAKE_URI
        string "Wake word server URI"
        default "tcp://127.0.0.1:10400"
        help
          URI of the wake word server

    config BR2_PACKAGE_WYOMING_SATELLITE_WAKE_WORD
        string "Wake word"
        default "ok wyoming"
        help
          Wake word to detect

    config BR2_PACKAGE_WYOMING_SATELLITE_LEDS
        bool "Enable LED support"
        help
          Enable LED support (requires rpi-lgpio, gpiozero, colorzero)
endif
```

## buildroot/packages/Config.in
```kconfig
source "$BR2_EXTERNAL_CUSTOM_PACKAGES_PATH/wifi-autoconfig/Config.in"
source "$BR2_EXTERNAL_CUSTOM_PACKAGES_PATH/usb-gadget/Config.in"
source "$BR2_EXTERNAL_CUSTOM_PACKAGES_PATH/expand-rootfs/Config.in"
source "$BR2_EXTERNAL_CUSTOM_PACKAGES_PATH/extra-configs/Config.in"
```

## buildroot/packages/base-config/Config.in
```kconfig
config BR2_PACKAGE_BASE_CONFIG
	bool "base-config"
	depends on BR2_LINUX_KERNEL
	help
	  Raspberry Pi configurations.
	  
	  Disables roaming and certain problematic features that
	  cause connection issues on Raspberry Pi boards.
```

## buildroot/packages/expand-rootfs/Config.in
```kconfig
config BR2_PACKAGE_EXPAND_ROOTFS
	bool "expand-rootfs"
	select BR2_PACKAGE_E2FSPROGS
	select BR2_PACKAGE_E2FSPROGS_RESIZE2FS
	select BR2_PACKAGE_E2FSPROGS_FSCK
	select BR2_PACKAGE_UTIL_LINUX
	select BR2_PACKAGE_UTIL_LINUX_BINARIES
	select BR2_PACKAGE_UTIL_LINUX_FINDMNT
	help
	  Automatically expand root filesystem to fill entire partition
	  on first boot.
	  
	  Uses tune2fs, fsck.ext4 and resize2fs to safely expand the
	  root filesystem. System will reboot automatically after
	  successful expansion.
	  
	  After reboot, /RESIZED flag prevents re-expansion.
```

## buildroot/packages/extra-configs/Config.in
```kconfig
config BR2_PACKAGE_EXTRA_CONFIGS
	bool "extra-configs"
	depends on BR2_USE_MMU # wpa_supplicant
	depends on BR2_PACKAGE_BUSYBOX_SHOW_OTHERS || BR2_PACKAGE_UTIL_LINUX
	select BR2_PACKAGE_OPENSSH
	help
	  Extra configurations.
```

## buildroot/packages/iwd-autoconfig/Config.in
```kconfig
config BR2_PACKAGE_IWD_AUTOCONFIG
	bool "iwd-autoconfig"
	depends on BR2_PACKAGE_IWD
	help
	  Auto-configure iwd WiFi from .psk files in /boot partition.
	  
	  This package installs an init script that automatically moves
	  .psk files from /boot to /var/lib/iwd on boot.

comment "iwd-autoconfig needs iwd"
	depends on !BR2_PACKAGE_IWD
```

## buildroot/packages/usb-gadget/Config.in
```kconfig
config BR2_PACKAGE_USB_GADGET
	bool "usb-gadget"
	depends on BR2_LINUX_KERNEL
	help
	  Simple USB gadget configuration for ACM serial console.
	  Provides a serial console on /dev/ttyGS0 accessible via USB.
```
